/*
 * gc9a01.c - GC9A01 240x240 round color TFT for MSPM0G3507 (driverlib, no framebuffer).
 * Init sequence ported from the 校赛B STM32 project; SPI/GPIO/delay use MSPM0 driverlib.
 * Pins come from SysConfig (ti_msp_dl_config.h): LCD_SPI_INST(SPI1) + GPIO_LCD_* .
 */
#include "ti_msp_dl_config.h"
#include "gc9a01.h"

#define CPUCLK_HZ   32000000UL      /* default MCLK (SYSCTL forceDefaultClkConfig) */
#define LCD_MADCTL  0xC8            /* MY+MX+BGR, matches 校赛B (panel orient) */

static void delay_ms(uint32_t ms) { while (ms--) delay_cycles(CPUCLK_HZ / 1000UL); }

/* ---- control pins ---- */
#define CS_L()   DL_GPIO_clearPins(GPIO_LCD_PORT, GPIO_LCD_LCD_CS_PIN)
#define CS_H()   DL_GPIO_setPins  (GPIO_LCD_PORT, GPIO_LCD_LCD_CS_PIN)
#define DC_CMD() DL_GPIO_clearPins(GPIO_LCD_PORT, GPIO_LCD_LCD_DC_PIN)
#define DC_DAT() DL_GPIO_setPins  (GPIO_LCD_PORT, GPIO_LCD_LCD_DC_PIN)
#define RES_L()  DL_GPIO_clearPins(GPIO_LCD_PORT, GPIO_LCD_LCD_RES_PIN)
#define RES_H()  DL_GPIO_setPins  (GPIO_LCD_PORT, GPIO_LCD_LCD_RES_PIN)

static inline void spi_wr(uint8_t b) { DL_SPI_transmitDataBlocking8(LCD_SPI_INST, b); }
static inline void spi_done(void)    { while (DL_SPI_isBusy(LCD_SPI_INST)) {} }

static void wr_cmd(uint8_t c) { DC_CMD(); CS_L(); spi_wr(c); spi_done(); CS_H(); }
static void wr_dat(uint8_t v) { DC_DAT(); CS_L(); spi_wr(v); spi_done(); CS_H(); }

/* ====================== GC9A01 vendor init ====================== */
static void gc9a01_init_seq(void)
{
    wr_cmd(0xEF);
    wr_cmd(0xEB); wr_dat(0x14);
    wr_cmd(0xFE);
    wr_cmd(0xEF);
    wr_cmd(0xEB); wr_dat(0x14);
    wr_cmd(0x84); wr_dat(0x40);
    wr_cmd(0x85); wr_dat(0xFF);
    wr_cmd(0x86); wr_dat(0xFF);
    wr_cmd(0x87); wr_dat(0xFF);
    wr_cmd(0x88); wr_dat(0x0A);
    wr_cmd(0x89); wr_dat(0x21);
    wr_cmd(0x8A); wr_dat(0x00);
    wr_cmd(0x8B); wr_dat(0x80);
    wr_cmd(0x8C); wr_dat(0x01);
    wr_cmd(0x8D); wr_dat(0x01);
    wr_cmd(0x8E); wr_dat(0xFF);
    wr_cmd(0x8F); wr_dat(0xFF);
    wr_cmd(0xB6); wr_dat(0x00); wr_dat(0x20);
    wr_cmd(0x36); wr_dat(LCD_MADCTL);
    wr_cmd(0x3A); wr_dat(0x05);              /* 16bit/pixel RGB565 */
    wr_cmd(0x90); wr_dat(0x08); wr_dat(0x08); wr_dat(0x08); wr_dat(0x08);
    wr_cmd(0xBD); wr_dat(0x06);
    wr_cmd(0xBC); wr_dat(0x00);
    wr_cmd(0xFF); wr_dat(0x60); wr_dat(0x01); wr_dat(0x04);
    wr_cmd(0xC3); wr_dat(0x13);
    wr_cmd(0xC4); wr_dat(0x13);
    wr_cmd(0xC9); wr_dat(0x22);
    wr_cmd(0xBE); wr_dat(0x11);
    wr_cmd(0xE1); wr_dat(0x10); wr_dat(0x0E);
    wr_cmd(0xDF); wr_dat(0x21); wr_dat(0x0C); wr_dat(0x02);
    wr_cmd(0xF0); wr_dat(0x45); wr_dat(0x09); wr_dat(0x08); wr_dat(0x08); wr_dat(0x26); wr_dat(0x2A);
    wr_cmd(0xF1); wr_dat(0x43); wr_dat(0x70); wr_dat(0x72); wr_dat(0x36); wr_dat(0x37); wr_dat(0x6F);
    wr_cmd(0xF2); wr_dat(0x45); wr_dat(0x09); wr_dat(0x08); wr_dat(0x08); wr_dat(0x26); wr_dat(0x2A);
    wr_cmd(0xF3); wr_dat(0x43); wr_dat(0x70); wr_dat(0x72); wr_dat(0x36); wr_dat(0x37); wr_dat(0x6F);
    wr_cmd(0xED); wr_dat(0x1B); wr_dat(0x0B);
    wr_cmd(0xAE); wr_dat(0x77);
    wr_cmd(0xCD); wr_dat(0x63);
    wr_cmd(0x70); wr_dat(0x07); wr_dat(0x07); wr_dat(0x04); wr_dat(0x0E); wr_dat(0x0F); wr_dat(0x09); wr_dat(0x07); wr_dat(0x08); wr_dat(0x03);
    wr_cmd(0xE8); wr_dat(0x34);
    wr_cmd(0x62); wr_dat(0x18); wr_dat(0x0D); wr_dat(0x71); wr_dat(0xED); wr_dat(0x70); wr_dat(0x70);
                  wr_dat(0x18); wr_dat(0x0F); wr_dat(0x71); wr_dat(0xEF); wr_dat(0x70); wr_dat(0x70);
    wr_cmd(0x63); wr_dat(0x18); wr_dat(0x11); wr_dat(0x71); wr_dat(0xF1); wr_dat(0x70); wr_dat(0x70);
                  wr_dat(0x18); wr_dat(0x13); wr_dat(0x71); wr_dat(0xF3); wr_dat(0x70); wr_dat(0x70);
    wr_cmd(0x64); wr_dat(0x28); wr_dat(0x29); wr_dat(0xF1); wr_dat(0x01); wr_dat(0xF1); wr_dat(0x00); wr_dat(0x07);
    wr_cmd(0x66); wr_dat(0x3C); wr_dat(0x00); wr_dat(0xCD); wr_dat(0x67); wr_dat(0x45); wr_dat(0x45); wr_dat(0x10); wr_dat(0x00); wr_dat(0x00); wr_dat(0x00);
    wr_cmd(0x67); wr_dat(0x00); wr_dat(0x3C); wr_dat(0x00); wr_dat(0x00); wr_dat(0x00); wr_dat(0x01); wr_dat(0x54); wr_dat(0x10); wr_dat(0x32); wr_dat(0x98);
    wr_cmd(0x74); wr_dat(0x10); wr_dat(0x85); wr_dat(0x80); wr_dat(0x00); wr_dat(0x00); wr_dat(0x4E); wr_dat(0x00);
    wr_cmd(0x98); wr_dat(0x3E); wr_dat(0x07);
    wr_cmd(0x35); wr_dat(0x00);
    wr_cmd(0x21);                            /* inversion on (GC9A01 normal) */
    wr_cmd(0x11); delay_ms(120);             /* sleep out */
    wr_cmd(0x29); delay_ms(20);              /* display on */
}

static void gc9a01_set_window(uint16_t x0, uint16_t y0, uint16_t x1, uint16_t y1)
{
    wr_cmd(0x2A);
    DC_DAT(); CS_L();
    spi_wr(x0 >> 8); spi_wr(x0 & 0xFF); spi_wr(x1 >> 8); spi_wr(x1 & 0xFF);
    spi_done(); CS_H();
    wr_cmd(0x2B);
    DC_DAT(); CS_L();
    spi_wr(y0 >> 8); spi_wr(y0 & 0xFF); spi_wr(y1 >> 8); spi_wr(y1 & 0xFF);
    spi_done(); CS_H();
    wr_cmd(0x2C);                            /* RAMWR: pixels follow */
}

void GC9A01_Backlight(uint8_t on)
{
    if (on) DL_GPIO_setPins(GPIO_LCD_PORT, GPIO_LCD_LCD_BLK_PIN);
    else    DL_GPIO_clearPins(GPIO_LCD_PORT, GPIO_LCD_LCD_BLK_PIN);
}

void GC9A01_Init(void)
{
    DL_SPI_enable(LCD_SPI_INST);
    /* hardware reset */
    RES_H(); delay_ms(10);
    RES_L(); delay_ms(20);
    RES_H(); delay_ms(120);
    gc9a01_init_seq();
}

void GC9A01_FillScreen(uint16_t color)
{
    uint8_t hi = (uint8_t)(color >> 8), lo = (uint8_t)(color & 0xFF);
    gc9a01_set_window(0, 0, LCD_W - 1, LCD_H - 1);
    DC_DAT(); CS_L();
    for (uint32_t i = 0; i < (uint32_t)LCD_W * LCD_H; i++) { spi_wr(hi); spi_wr(lo); }
    spi_done(); CS_H();
}

void GC9A01_FillRect(int16_t x, int16_t y, int16_t w, int16_t h, uint16_t color)
{
    if (w <= 0 || h <= 0) return;
    if (x < 0) { w += x; x = 0; }
    if (y < 0) { h += y; y = 0; }
    if (x + w > LCD_W) w = LCD_W - x;
    if (y + h > LCD_H) h = LCD_H - y;
    if (w <= 0 || h <= 0) return;
    uint8_t hi = (uint8_t)(color >> 8), lo = (uint8_t)(color & 0xFF);
    gc9a01_set_window(x, y, x + w - 1, y + h - 1);
    DC_DAT(); CS_L();
    for (uint32_t i = 0; i < (uint32_t)w * h; i++) { spi_wr(hi); spi_wr(lo); }
    spi_done(); CS_H();
}

void GC9A01_DrawPixel(int16_t x, int16_t y, uint16_t color)
{
    if (x < 0 || y < 0 || x >= LCD_W || y >= LCD_H) return;
    uint8_t hi = (uint8_t)(color >> 8), lo = (uint8_t)(color & 0xFF);
    gc9a01_set_window(x, y, x, y);
    DC_DAT(); CS_L();
    spi_wr(hi); spi_wr(lo);
    spi_done(); CS_H();
}

/* ====================== 8x8 font (printable ASCII 0x20-0x7E), row-major, LSB=left ====================== */
static const uint8_t FONT8x8[96][8] = {
{0x00,0x00,0x00,0x00,0x00,0x00,0x00,0x00},{0x18,0x3C,0x3C,0x18,0x18,0x00,0x18,0x00},
{0x36,0x36,0x00,0x00,0x00,0x00,0x00,0x00},{0x36,0x36,0x7F,0x36,0x7F,0x36,0x36,0x00},
{0x0C,0x3E,0x03,0x1E,0x30,0x1F,0x0C,0x00},{0x00,0x63,0x33,0x18,0x0C,0x66,0x63,0x00},
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{0x6E,0x3B,0x00,0x00,0x00,0x00,0x00,0x00},{0x00,0x00,0x00,0x00,0x00,0x00,0x00,0x00},
};

/* 逐点慢路径: 透明底或越界裁剪时用(FillRect 内部会裁剪)。 */
static void draw_char_slow(int16_t x, int16_t y, const uint8_t *g,
                           uint16_t fg, uint16_t bg, uint8_t scale)
{
    for (uint8_t row = 0; row < 8; row++) {
        uint8_t bits = g[row];
        for (uint8_t col = 0; col < 8; col++) {
            uint16_t c = (bits & (1u << col)) ? fg : bg;
            if (c == 0xFFFE) continue;               /* 0xFFFE == transparent bg sentinel */
            GC9A01_FillRect(x + col * scale, y + row * scale, scale, scale, c);
        }
    }
}

/*
 * 2026-07-27 改写: 不透明底走"一次 set_window + 整块像素流"。
 *   旧版对字模逐 bit 调一次 FillRect => **每个字符 64 次 set_window**(每次=2条命令+8字节坐标+
 *   CS/DC 翻转+spi_done 忙等)。scale=3 时一个字符约 1856 字节, 一行 9 字约 33ms —— 这正是本工程
 *   历史上"数主循环拍×假设1ms → 报的 RPM 虚高 5x"(commit 4bbaae5 修掉)的**机制层根因**:
 *   当时只治了症状(改用 SysTick 真实时基), 没查"LCD 为什么这么慢"。
 *   现在 scale=3 一个字符 = 1 次 set_window + 1152 字节连续流, 并省掉 63 次窗口/CS 开销。
 * 判据(可自测): 有效像素字节 / 实际发出字节 —— 旧版约 0.62 且窗口开销不随时钟缩短, 新版≈1.0。
 */
void GC9A01_DrawChar(int16_t x, int16_t y, char ch, uint16_t fg, uint16_t bg, uint8_t scale)
{
    if (ch < 0x20 || ch > 0x7E) ch = ' ';
    if (scale < 1) scale = 1;
    const uint8_t *g = FONT8x8[(uint8_t)ch - 0x20];
    int16_t w = (int16_t)(8 * scale);

    /* 透明底无法整块流(要跳过背景像素); 越界也交给慢路径, 由 FillRect 做裁剪 */
    if (bg == 0xFFFE || x < 0 || y < 0 || x + w > LCD_W || y + w > LCD_H) {
        draw_char_slow(x, y, g, fg, bg, scale);
        return;
    }
    uint8_t fh = (uint8_t)(fg >> 8), fl = (uint8_t)(fg & 0xFF);
    uint8_t bh = (uint8_t)(bg >> 8), bl = (uint8_t)(bg & 0xFF);
    gc9a01_set_window(x, y, x + w - 1, y + w - 1);
    DC_DAT(); CS_L();
    for (uint8_t row = 0; row < 8; row++) {
        uint8_t bits = g[row];
        for (uint8_t ry = 0; ry < scale; ry++) {                 /* 纵向放大: 同一行重复 scale 次 */
            for (uint8_t col = 0; col < 8; col++) {
                int on = (bits & (1u << col)) ? 1 : 0;
                for (uint8_t rx = 0; rx < scale; rx++) {         /* 横向放大 */
                    if (on) { spi_wr(fh); spi_wr(fl); } else { spi_wr(bh); spi_wr(bl); }
                }
            }
        }
    }
    spi_done(); CS_H();
}

void GC9A01_DrawCircle(int16_t cx, int16_t cy, int16_t r, uint16_t color, uint8_t dot)
{
    if (r <= 0) return;
    if (dot < 1) dot = 1;
    int16_t x = r, y = 0, err = 0;
    uint16_t n = 0;
    while (x >= y) {
        if ((n++ % dot) == 0) {                                  /* 虚线环: 只画每第 dot 个点 */
            GC9A01_DrawPixel(cx + x, cy + y, color); GC9A01_DrawPixel(cx + y, cy + x, color);
            GC9A01_DrawPixel(cx - y, cy + x, color); GC9A01_DrawPixel(cx - x, cy + y, color);
            GC9A01_DrawPixel(cx - x, cy - y, color); GC9A01_DrawPixel(cx - y, cy - x, color);
            GC9A01_DrawPixel(cx + y, cy - x, color); GC9A01_DrawPixel(cx + x, cy - y, color);
        }
        y++; err += 1 + 2 * y;
        if (2 * (err - x) + 1 > 0) { x--; err += 1 - 2 * x; }
    }
}

void GC9A01_FillCircle(int16_t cx, int16_t cy, int16_t r, uint16_t color)
{
    if (r < 0) return;
    int32_t r2 = (int32_t)r * r;
    for (int16_t dy = -r; dy <= r; dy++) {
        int16_t dx = 0;                                          /* 整数开方: 不引 sqrt */
        while ((int32_t)(dx + 1) * (dx + 1) + (int32_t)dy * dy <= r2) dx++;
        GC9A01_FillRect(cx - dx, cy + dy, (int16_t)(2 * dx + 1), 1, color);
    }
}

void GC9A01_DrawString(int16_t x, int16_t y, const char *s, uint16_t fg, uint16_t bg, uint8_t scale)
{
    if (scale < 1) scale = 1;
    while (*s) {
        GC9A01_DrawChar(x, y, *s, fg, bg, scale);
        x += 8 * scale;                              /* 8px cell */
        s++;
    }
}

void GC9A01_DrawStringCentered(int16_t y, const char *s, uint16_t fg, uint16_t bg, uint8_t scale)
{
    int len = 0; const char *p = s; while (*p++) len++;
    int16_t w = (int16_t)(len * 8 * scale);
    GC9A01_DrawString((LCD_W - w) / 2, y, s, fg, bg, scale);
}
