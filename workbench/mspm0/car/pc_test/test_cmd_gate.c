/*
 * test_cmd_gate.c - cmd_gate.h(串口命令格式门) 的 PC 单元测试
 *
 * 编译运行(在本目录):
 *   gcc -O2 -Wall -I.. -o test_cmd_gate test_cmd_gate.c
 *   .\test_cmd_gate.exe            (Windows)   /   ./test_cmd_gate   (Linux)
 *
 * 为什么值得单测: 这个门挡的是一个**已在真机坐实的 bug** —— 车载 ESP-01S 每次上电
 * 从 TXD 吐的 boot 日志会灌进 MCU 的 UART3(PB3), 而旧解析"遇 \r\n 就把整行首字符当命令",
 * 于是 `tail 0` / `tail 4` / `tail 0` 三行触发 `t`(设定目标) => 静默改目标 + 清 PID 积分。
 *
 * 覆盖:
 *   1  正例: 现有 6 个 .ps1 工具实际会发的命令全集, 必须 100% 过门
 *   2  反例: ESP boot 日志的典型行 + 常见畸形输入, 必须全拒
 *   3  回归: 拿 650 字节**真实 boot 流**(无线遥测_ESP01S_boot字节证据.txt 原始字节)
 *      按固件的行切分规则跑一遍 —— 旧逻辑会触发 3 次 't', 新逻辑必须 0 次命令
 *
 * 边界(诚实): 本测试验的是"门的判断"与"行切分规则"。上电静默窗(CMD_MUTE_MS)依赖 SysTick,
 * 双口 RX 依赖 UART 外设, 那两部分只能真机验 => 见 无线遥测_ESP01S链路.md §7。
 */
#include "cmd_gate.h"
#include <stdio.h>
#include <string.h>

static int g_fail = 0;

static void expect(const char *s, int want)
{
    int got = cmd_format_ok(s, (int)strlen(s));
    if (got == want) {
        printf("  [PASS] %-24s -> %s\n", s, got ? "ACCEPT" : "reject");
    } else {
        printf("  [FAIL] %-24s -> %s (want %s)\n", s, got ? "ACCEPT" : "reject",
               want ? "ACCEPT" : "reject");
        g_fail++;
    }
}

/* ---- 1. 正例: 六个 .ps1 工具实际会发的命令全集(逐个从脚本里对过) ---- */
static void test_real_commands_accepted(void)
{
    printf("test_real_commands_accepted (现有脚本发的必须全过):\n");
    /* uart_send / tune_step / pos_step / disturb_test / xtalk / iloop 会发的 */
    expect("m0", 1); expect("m2", 1); expect("m3", 1); expect("m7", 1);
    expect("t900", 1); expect("t0", 1); expect("t500", 1);
    expect("p150", 1); expect("i20", 1); expect("d0", 1); expect("d50", 1);
    expect("f20", 1);  expect("f100", 1);
    expect("w12", 1);  expect("e15", 1);
    expect("x30", 1);  expect("y30", 1);
    expect("z", 1);                        /* 急停: 单字母无参 */
    expect("?", 1);                        /* 查询状态: 唯一的非字母命令(特例放行) */
    expect("v100", 1); expect("r30", 1);
    expect("r-30", 1); expect("v-100", 1); /* 负参数 */
    expect("s-1", 1);  expect("s1", 1);
    expect("a2", 1);   expect("o", 1); expect("k", 1); expect("g", 1);
    expect("u0", 1);   expect("u1", 1);
    expect("l3", 1);                       /* 新增: 遥测去向 */
    expect("h10000", 1);
    expect("#t500", 1);                    /* 可选帧头 */
    expect("#?", 1);
}

/* ---- 2. 反例: ESP boot 日志典型行 + 畸形输入 ---- */
static void test_boot_noise_rejected(void)
{
    printf("test_boot_noise_rejected (ESP boot 日志与畸形输入必须全拒):\n");
    expect("tail 0", 0);                   /* ★ 就是这行害的: 首字符 t = 设定目标 */
    expect("tail 4", 0);                   /* ★ */
    expect("chksum 0xf3", 0);
    expect("csum 0x22", 0);
    expect("load 0x40100000, len 2592, room 16 ", 0);
    expect("ready", 0);                    /* 字母后面还是字母 */
    expect("OK", 0);
    expect("AT+RST", 0);
    expect("2nd boot version : 1.7(5d6f877)", 0);
    expect("SPI Speed : 40MHz", 0);
    expect("jump to run user1 @ 1000", 0);
    expect(">", 0);                        /* 提示符: 非字母且非 '?' */
    expect("Ai-Thinker Technology Co. Ltd.", 0);
    /* 畸形/边界 */
    expect("", 0);
    expect("#", 0);                        /* 只有帧头 */
    expect("t 900", 0);                    /* 中间有空格 */
    expect("t900x", 0);                    /* 数字后面还有字母 */
    expect("t-", 0);                       /* 只有负号没有数字 -> 形状不完整, 应拒 */
    expect("-30", 0);                      /* 没有命令字 */
    expect("??", 0);                       /* '?' 只放行裸的一个 */
    expect("t9?0", 0);
}

/* ---- 3. 回归: 650 字节真实 boot 流(证据文件的原始字节, 逐字节等价) ----
 * 来源: workbench/天猛星主板平台/无线遥测_ESP01S_boot字节证据.txt (esp_boot_risk.ps1 抓的原始流)
 * 这里内嵌成数组是为了让测试**自包含**(不依赖含中文的相对路径, 换机/换 shell 都能跑)。 */
static const unsigned char BOOT[] = {
    0x41, 0x54, 0x2B, 0x52, 0x53, 0x54, 0x0D, 0x0A, 0x0D, 0x0A, 0x4F, 0x4B, 0x0D, 0x0A, 0x0D, 0x0A,
    0x20, 0x65, 0x74, 0x73, 0x20, 0x4A, 0x61, 0x6E, 0x20, 0x20, 0x38, 0x20, 0x32, 0x30, 0x31, 0x33,
    0x2C, 0x72, 0x73, 0x74, 0x20, 0x63, 0x61, 0x75, 0x73, 0x65, 0x3A, 0x31, 0x2C, 0x20, 0x62, 0x6F,
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    0x0A, 0x0D, 0x0A, 0x72, 0x65, 0x61, 0x64, 0x79, 0x0D, 0x0A,
};

/* 镜像 car.c 里 feed_cmd_stream() 的行切分规则: 缓冲 16 字节、最多存 15、遇 \r 或 \n 成行。
 * gate=0 = 旧逻辑(无门), gate=1 = 现在的逻辑。返回"会触发几条命令", 并统计首字母分布。 */
static int replay_boot(int gate, char *letters, int letters_sz)
{
    char buf[16];
    int  len = 0, fired = 0, nl = 0;
    size_t i;

    for (i = 0; i < sizeof(BOOT); i++) {
        unsigned char ch = BOOT[i];
        if (ch == '\r' || ch == '\n') {
            if (len > 0) {
                if (!gate || cmd_format_ok(buf, len)) {
                    fired++;
                    if (nl < letters_sz - 1) letters[nl++] = buf[0];
                }
            }
            len = 0;
        } else if (len < 15) {
            buf[len++] = (char)ch;
        }
    }
    letters[nl] = '\0';
    return fired;
}

static void test_real_boot_stream_regression(void)
{
    char old_letters[64], new_letters[64];
    int old_fired, new_fired, t_count = 0, i;

    printf("test_real_boot_stream_regression (650 字节真实 boot 流):\n");

    old_fired = replay_boot(0, old_letters, (int)sizeof(old_letters));
    new_fired = replay_boot(1, new_letters, (int)sizeof(new_letters));

    for (i = 0; old_letters[i]; i++) if (old_letters[i] == 't') t_count++;

    printf("    旧逻辑(无门): %d 行会被当命令执行, 首字母序列 = \"%s\"\n", old_fired, old_letters);
    printf("    其中 't'(设定目标 + 清 PID 积分) 被触发 %d 次\n", t_count);
    printf("    新逻辑(有门): %d 行通过\n", new_fired);

    if (t_count == 3) {
        printf("  [PASS] 复现了原始故障: 旧逻辑触发 3 次 't'(与文档记录一致)\n");
    } else {
        printf("  [FAIL] 期望旧逻辑触发 3 次 't', 实际 %d 次 —— 测试数据或切分规则变了\n", t_count);
        g_fail++;
    }
    if (new_fired == 0) {
        printf("  [PASS] 格式门把 650 字节 boot 流里的每一行都拒掉了(0 条命令通过)\n");
    } else {
        printf("  [FAIL] 仍有 %d 行过门: \"%s\"\n", new_fired, new_letters);
        g_fail++;
    }
}

int main(void)
{
    printf("==== cmd_gate.h PC unit test ====\n");
    test_real_commands_accepted();
    test_boot_noise_rejected();
    test_real_boot_stream_regression();
    printf("==== %s ====\n", g_fail ? "FAIL" : "ALL PASS");
    return g_fail ? 1 : 0;
}
